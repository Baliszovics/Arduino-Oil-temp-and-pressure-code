unsigned long timer[5], ch[3], ch2[3], faktor[1];
byte last_channel[1];
int input[3];
int pulse = 0;
double dispValues[3];
float maxTemp = -40;
float maxPres = 0;
float PresCorr = 0.88;

float R1 = 27000.0; //Resistor R1 27k ohm +/-1%
float R2 = 4700.0; //Resistor R2 4,7k ohm +/-1% 

#include <Wire.h>
#include <Adafruit_GFX.h>
#include <Adafruit_SSD1306.h>

#define SCREEN_WIDTH 128 // OLED display width, in pixels
#define SCREEN_HEIGHT 64 // OLED display height, in pixels

Adafruit_SSD1306 display(SCREEN_WIDTH, SCREEN_HEIGHT, &Wire, -1);
const unsigned char LOGO [] PROGMEM = {
  // Subaru logo, 128x64px
  0x00, 0x00, 0x00, 0x00, 0x00, 0x00, 0x00, 0x7f, 0xff, 0x00, 0x00, 0x00, 0x00, 0x00, 0x00, 0x00,
  0x00, 0x00, 0x00, 0x00, 0x00, 0x01, 0xff, 0xff, 0xff, 0xff, 0x80, 0x00, 0x00, 0x00, 0x00, 0x00,
  0x00, 0x00, 0x00, 0x00, 0x00, 0x7f, 0xff, 0xff, 0xff, 0xff, 0xfe, 0x00, 0x00, 0x00, 0x00, 0x00,
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  0x00, 0x00, 0x00, 0x00, 0x00, 0x00, 0x00, 0xff, 0xff, 0x00, 0x00, 0x00, 0x00, 0x00, 0x00, 0x00
};

const unsigned char snowflake [] PROGMEM {
  // Snowflake icon, 9x9px
  0x08, 0x00, 0x2a, 0x00, 0x6b, 0x00, 0x14, 0x00, 0xeb, 0x80, 0x14, 0x00, 0x6b, 0x00, 0x2a, 0x00,
  0x08, 0x00
};

const unsigned char TBM_logo [] PROGMEM = {
  // 'TBM logo', 9x8px
  0x80, 0x80, 0x80, 0x80, 0xbe, 0x80, 0xe3, 0x80, 0xeb, 0x80, 0xff, 0x80, 0x7f, 0x00, 0x3e, 0x00
};


void setup() {
  PCICR |= (1 << PCIE0); //D8 PIN
  PCMSK0 |= (1 << PCINT0);
  delay(2000);
  Serial.begin(9600);
  if (!display.begin(SSD1306_SWITCHCAPVCC, 0x3D)) { // Address 0x3D for 128x64
    Serial.println(F("SSD1306 allocation failed"));
    for (;;);
  }
  display.clearDisplay();
  display.drawBitmap(0, 0, LOGO, 128, 64, WHITE); //SUBARU LOGO
  display.display();
  delay(2000);
}


void loop() {
  delay(1);
  display.clearDisplay();
  /*********** BORDERS ***********/
  display.drawRect(0, 0, 128, 18, WHITE); //upper border
  display.drawRect(0, 17, 128, 47, WHITE); //lower border
  display.drawLine(63, 17, 63, 63, WHITE); //vertical divider border
  display.drawLine(0, 52, 128, 52, WHITE); //lower divider border

  display.setTextColor(WHITE);
  display.setTextSize(2);
  display.setCursor(11, 2);
  display.print("MOTOROLAJ"); // ENGINE OIL in hungarian


  /*********** TEMPERATURE VALUE ***********/
  display.setTextSize(1); //display the word "Hőfok" - temperature in hungarian
  display.setCursor(17, 19);
  display.print("H");
  display.print((char)147); //"ő" character
  display.print("fok");

  display.setTextSize(2);
  //if (dispValues[0] < 100.000000000000000000000000000000000000000000000000000000000000000000000000000000000000) {
  //  display.setCursor(26, 28);
  //}
  //else
  display.setCursor(13, 28);
  if (dispValues[0] < 65) {  //below 65 °C character in inverse, snowflake icon appears
    display.setTextColor(BLACK);
    display.fillRect(2, 27, 60, 16, WHITE);
    display.print(dispValues[0] , 0); //temp value rounded up

    display.drawBitmap(3, 33, snowflake, 9, 9, BLACK); //snowflake bitmap

    display.setTextColor(BLACK);
    display.setTextSize(1);
    display.setCursor(50, 35);
    display.print((char)247); //"°" character
    display.print("C");
  }
  else {
    display.setTextColor(WHITE);
    display.print(dispValues[0], 0); //under 65 °C text color changes to white, snowflake icon disappears
    display.setTextColor(WHITE);
    display.setTextSize(1);
    display.setCursor(50, 36);
    display.print((char)247); //"°" character
    display.print("C");
  }
  /*********** TEMPERATURE MAX VALUE DISPLAY ***********/
  if (dispValues[0] > maxTemp) maxTemp = dispValues[0]; //max temp inspection
  display.setTextSize(1);
  display.setTextColor(WHITE);
  display.setCursor(2, 44);
  display.print("max:");
  display.setCursor(26, 44);
  display.print(maxTemp, 0); // max temp value
  

  /*********** PRESSURE VALUE ***********/
  display.setTextSize(1); //display the word "nyomás" - pressure in hungarian
  display.setCursor(77, 19);
  display.print("Nyom");
  display.print((char)160); //"á" character
  display.print("s");

  display.setTextSize(2);
  display.setCursor(71, 28);
  if ((dispValues[1] - PresCorr) < 0.1)
  display.print (0.0, 1);
  else
  display.print(dispValues[1] - PresCorr, 1); //pressure value correction to show 0 or above, this case it is -0.88 because the sensor reads the absolute pressure, like air pressure.

  display.setTextSize(1);
  display.setCursor(108, 35);
  display.print("Bar");

  /*********** PRESSURE MAX VALUE DISPLAY ***********/
  if (dispValues[1] > maxPres) maxPres = dispValues[1]; 
  display.setTextSize(1);
  display.setTextColor(WHITE);
  display.setCursor(65, 44);
  display.print("max:");
  display.setCursor(89, 44);
  display.print(maxPres - PresCorr, 1); //max pressure inspection with correction mentioned above

  
  /*********** BATTERY VOLTAGE ***********/
  /*this is made with divider resistors and a calculation. 
  Maybe it is good or maybe it is off a bit, I am not that good in electricity. 
  I double checked the values with a multimeter and added correction value accordingly*/
  int Pin; 
  double Vin;
  Pin = analogRead(A0); // A0 reads the value and add to the "Pin" variable
  Vin = (((Pin + 0.5) * 5.0 / 1024.0)-0.15) * ((R1+R2)/R2); // voltage value processed with this case -0,15 correction
                                                            // if you want to measure voltage above 5 V you have to use divider resistors: *R2/(R1+R2)
                                                            // around 12 V : 12 [V] * 4700 [Ohm] / (27000 [Ohm] + 4700 [Ohm]) = 1,7792 V
  Vin = constrain(Vin, 0, 16); //Vin value limited betveen 0-16
  display.setTextSize(1);
  display.setTextColor(WHITE);
  display.setCursor(2, 54);
  display.print("Akku:"); //Battery in hungarian
  if (Vin < 11.8) {
    display.setTextColor(BLACK);
    display.fillRect(31, 54, 31, 8, WHITE);
    display.print (Vin, 1);
    display.print ("V");
  }
  else{
    display.print(Vin, 1);
    display.print("V");
  }

  /***LOGO***/
  display.drawBitmap(99, 54, TBM_logo, 9, 8, WHITE); //TBM_logo bitmap
  display.setTextSize(1);
  display.setTextColor (WHITE);
  display.setCursor(109, 54);
  display.print("TBM");
  //display.setFont(u8g2_font_u8glib_4_hf);
  
  display.display();
}


ISR(PCINT0_vect) { //this is the actual sensor reading
  timer[0] = micros();

  if (last_channel[0] == 0 && PINB & B00000001 ) {
    last_channel[0] = 1;
    ch[pulse] = timer[0] - timer[1];
    timer[1] = timer[0];
    if (ch[pulse] < 3000) {
      pulse = 0;
    } else {
      pulse++;
    }

  }
  else if (last_channel[0] == 1 && !(PINB & B00000001) ) {
    last_channel[0] = 0;
    input[pulse] = timer[0] - timer[1];
    if (pulse == 0) {
      dispValues[0] = ((4096.0 / ch[0]) * input[0] - 128) / 19.2 - 40;
    } else if (pulse == 1) {
      dispValues[1] = (((4096.0 / ch[1]) * input[1]) - 128) / 384.0 + 0.5;
    } else if (pulse == 2) {
      dispValues[2] = (1024.0 / ch[2]) * input[2];
      if (dispValues[2] >= 231.00 && dispValues[2] <= 281.00) {
        dispValues[2] = 1;
      }
    }
  }
}
